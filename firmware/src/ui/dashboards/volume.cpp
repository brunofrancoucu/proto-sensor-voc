#include "ui/dashboards.h"
// Internal
#include "core/state.h"
#include "ui/molecules.h"
#include "ui/buzzer.h"

static const unsigned char PROGMEM image_volume_0[] = {0x00,0x00,0x00,0x00,0x01,0x00,0x03,0xf0,0x00,0x00,0x00,0x0c,0x30,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0x00,0x00};
static const unsigned char PROGMEM image_volume_1[] = {0x00,0x03,0xf0,0x00,0x00,0x00,0x03,0xf0,0x00,0x00,0x00,0x0c,0x30,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0x00,0x00};
static const unsigned char PROGMEM image_volume_2[] = {0x00,0x03,0xf0,0x00,0x00,0x00,0x03,0xf0,0x00,0x00,0x00,0x0c,0x30,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0x00,0x00};
static const unsigned char PROGMEM image_volume_3[] = {0x00,0x03,0xf0,0x03,0x00,0x00,0x03,0xf0,0x03,0x00,0x00,0x0c,0x30,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0x00,0x00};

static const std::vector<const unsigned char*> vol_icon = {
    image_volume_0,
    image_volume_1,
    image_volume_2,
    image_volume_3
};

VolumeView volumeView;

void VolumeView::paint() {
    static int volLast = -1; // value
    static int volIconId = -1; // map()

    // volume
    if (volLast != state.system.volume) {
        volLast = state.system.volume;
        volIconId = map(state.system.volume, 0, 100, 0, 3);
    }

    paintSetting(vol_icon[volIconId], String(state.system.volume) + " %", 1.25);
}

void VolumeView::onInput(Button& button) {
    if (button.pin == state.input.pins.LFT) {
        // LFT();
        if (state.system.volume >= 0) {
            state.system.volume = max(0, state.system.volume - 3);
            playTone(500, 25);
        }
    } else if (button.pin == state.input.pins.MID) {
        // MID();
        state.display.navTo(&menuView);
    } else if (button.pin == state.input.pins.RGT) {
        // RGT();
        if (state.system.volume <= 100) {
            state.system.volume = min(100, state.system.volume + 3);
            playTone(523, 25);
        }
    }
}