#include "ui/instances.h"
// Dual config page
#include "core/state.h" 
#include "ui/atomic.h"
#include "helpers/cache.h"

static const unsigned char PROGMEM image_display_brightness_bits[] = {0x01,0x00,0x21,0x08,0x10,0x10,0x03,0x80,0x8c,0x62,0x48,0x24,0x10,0x10,0x10,0x10,0x10,0x10,0x48,0x24,0x8c,0x62,0x03,0x80,0x10,0x10,0x21,0x08,0x01,0x00,0x00,0x00};
static const unsigned char PROGMEM image_display_brightness_bits_lg[] = {0x00,0x03,0x00,0x00,0x00,0x03,0x00,0x00,0x0c,0x03,0x00,0xc0,0x0c,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0x00,0x00};

BrightnessView brightnessView("Brillo", image_display_brightness_bits);

auto brghtPct = memo([](uint8_t b) {return map(b, 0, 255, 0, 100);});

void BrightnessView::paint() {
    paintSetting(image_display_brightness_bits_lg, String(brghtPct.get(state.system.brightness)) + " %");
}

void BrightnessView::onInput(Button& button) {
    uint8_t& prev = state.system.brightness;

    if (button.pin == state.input.pins.LFT) {
        // LFT();
        state.system.brightness = max(1, prev - 8); // 255/100*3
    } else if (button.pin == state.input.pins.MID) {
        // MID();
        state.display.navTo(&menuView);
    } else if (button.pin == state.input.pins.RGT) {
        // RGT();
        state.system.brightness = min(255, prev + 8); // 255/100*3
    }

    state.display.setBrightness(state.system.brightness);
}

void BrightnessView::enter() {
    btmbar.content.txtL = "Bajar";
    btmbar.content.txtR = "Subir";
}