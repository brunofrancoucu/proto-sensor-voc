#include "ui/instances.h"
// Internal
#include "core/state.h"
#include "ui/atomic.h"
#include "hmi/buzzer.h"
#include "helpers/cache.h"

static const unsigned char PROGMEM image_volume_custom_sm[] = {0x01,0xc0,0x02,0x40,0x04,0x48,0x08,0x44,0xf0,0x42,0x80,0x52,0x80,0x49,0x80,0x49,0x80,0x49,0x80,0x52,0xf0,0x42,0x08,0x44,0x04,0x48,0x02,0x40,0x01,0xc0,0x00,0x00};
static const unsigned char PROGMEM image_volume_0[] = {0x00,0x00,0x00,0x00,0x01,0x00,0x03,0xf0,0x00,0x00,0x00,0x0c,0x30,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0x00,0x00};
static const unsigned char PROGMEM image_volume_1[] = {0x00,0x03,0xf0,0x00,0x00,0x00,0x03,0xf0,0x00,0x00,0x00,0x0c,0x30,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0x00,0x00};
static const unsigned char PROGMEM image_volume_2[] = {0x00,0x03,0xf0,0x00,0x00,0x00,0x03,0xf0,0x00,0x00,0x00,0x0c,0x30,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0x00,0x00};
static const unsigned char PROGMEM image_volume_3[] = {0x00,0x03,0xf0,0x03,0x00,0x00,0x03,0xf0,0x03,0x00,0x00,0x0c,0x30,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0x00,0x00};
static const std::vector<const unsigned char*> vol_icon = {
    image_volume_0,
    image_volume_1,
    image_volume_2,
    image_volume_3
};

VolumeView volumeView("Volumen", image_volume_custom_sm);

auto iconId = memo([](uint8_t volume) {return map(volume + (255 + 255 / 3) / 3, 0, 255 + 255 / 3, 0, 3);});
auto volPct = memo([](uint8_t volume) {return map(volume, 0, 255, 0, 100);});

void VolumeView::paint() {
    paintSetting(vol_icon[iconId.get(state.system.volume)], String(volPct.get(state.system.volume)) + " %", 1.25);
}

void VolumeView::onInput(Button& button) {
    if (button.pin == state.input.pins.LFT) {
        // LFT();
        if (state.system.volume >= 0) {
            state.system.volume = max(0, state.system.volume - 8); // 255/100*3
            playTone(500, 25);
        }
    } else if (button.pin == state.input.pins.MID) {
        // MID();
        state.display.navTo(&menuView);
    } else if (button.pin == state.input.pins.RGT) {
        // RGT();
        if (state.system.volume <= 255) {
            state.system.volume = min(255, state.system.volume + 8); // 255/100*3
            playTone(523, 25);
        }
    }
}

void VolumeView::enter() {
    btmbar.content.txtL = "Bajar";
    btmbar.content.txtR = "Subir";
}